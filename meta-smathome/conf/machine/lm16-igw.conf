## meta-smathome/conf/machine/lm16-igw.conf
```bitbake
#@TYPE: Machine
#@NAME: Xiaomi Smart Home Gateway
#@SOC: i.MX6ULL
#@DESCRIPTION: Machine configuration for Xiaomi Smart Home Gateway
#@MAINTAINER: Eugeny Shcheglov <eugenyshcheglov@gmail.com>

MACHINEOVERRIDES =. "mx6:mx6ull:"

include conf/machine/imx6ullevk.conf

KERNEL_DEVICETREE += "lm16-igw.dtb"
UBOOT_CONFIG = "nand"

# TODO: find suitable NAND config 
# UBOOT_CONFIG[nand] = "mx6ull_14x14_evk_nand_config,ubifs"

PREFERRED_PROVIDER_u-boot = "u-boot-imx"
PREFERRED_PROVIDER_virtual/bootloader = "u-boot-imx"
PREFERRED_PROVIDER_virtual/kernel = "linux-imx"
```
